## config/boards/shields/ykeeb/Kconfig.defconfig
```kconfig
if SHIELD_YKEEB_LEFT

config ZMK_KEYBOARD_NAME
    default "Ykeeb"

config ZMK_SPLIT_ROLE_CENTRAL
    default y

CONFIG_ZMK_MOUSE=y

endif

if SHIELD_YKEEB_LEFT || SHIELD_YKEEB_RIGHT
config ZMK_SPLIT
    default y
endif
```

## config/boards/shields/ykeeb/Kconfig.shield
```kconfig
config SHIELD_YKEEB_LEFT
    def_bool $(shields_list_contains,ykeeb_left)

config SHIELD_YKEEB_RIGHT
    def_bool $(shields_list_contains,ykeeb_right)
```

## config/west.yml
```yaml
manifest:
  remotes:
    - name: zmkfirmware
      url-base: https://github.com/zmkfirmware
    - name: krikun98
      url-base: https://github.com/krikun98
    - name: mouse-3.2
      url-base: https://github.com/urob/zmk/tree/mouse-3.2
  projects:
    - name: zmk
      remote: ftc
      revision: mouse-ftc
      import: app/west.yml
  self:
    path: config
```
